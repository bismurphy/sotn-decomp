SECTIONS
{
    __romPos = 0;
    _gp = 0x0;
    dra_ROM_START = __romPos;
    dra_VRAM = ADDR(.dra);
    .dra 0x800A0000 : AT(dra_ROM_START) SUBALIGN(4)
    {
        dra_DATA_START = .;
        _0_data__s = .;
        build/us/asm/us/dra/data/0.data.s.o(.data);
        _518_data__s = .;
        build/us/asm/us/dra/data/518.data.s.o(.data);
        save_mgr_c = .;
        build/us/src/dra/save_mgr.c.o(.data);
        _21B8_data__s = .;
        build/us/asm/us/dra/data/21B8.data.s.o(.data);
        _2BC0_data__s = .;
        build/us/asm/us/dra/data/2BC0.data.s.o(.data);
        _5D6C4_c = .;
        build/us/src/dra/5D6C4.c.o(.data);
        _2EE8_data__s = .;
        build/us/asm/us/dra/data/2EE8.data.s.o(.data);
        _3C40_data__s = .;
        build/us/asm/us/dra/data/3C40.data.s.o(.data);
        _4A00_data__s = .;
        build/us/asm/us/dra/data/4A00.data.s.o(.data);
        equipment = .;
        build/us/assets/dra/equipment.o(.data);
        accessory = .;
        build/us/assets/dra/accessory.o(.data);
        _8258_data__s = .;
        build/us/asm/us/dra/data/8258.data.s.o(.data);
        _8900_data__s = .;
        build/us/asm/us/dra/data/8900.data.s.o(.data);
        CEB0_data__s = .;
        build/us/asm/us/dra/data/CEB0.data.s.o(.data);
        _6D59C_c = .;
        build/us/src/dra/6D59C.c.o(.data);
        CF4C_data__s = .;
        build/us/asm/us/dra/data/CF4C.data.s.o(.data);
        D670_data__s = .;
        build/us/asm/us/dra/data/D670.data.s.o(.data);
        _2217C_data__s = .;
        build/us/asm/us/dra/data/2217C.data.s.o(.data);
        _227B0_data__s = .;
        build/us/asm/us/dra/data/227B0.data.s.o(.data);
        dra_DATA_END = .;
        dra_DATA_SIZE = ABSOLUTE(dra_DATA_END - dra_DATA_START);
        dra_RODATA_START = .;
        build/us/asm/us/dra/data/3B3B0.rodata.s.o(.rodata);
        build/us/src/dra/42398.c.o(.rodata);
        build/us/src/dra/play.c.o(.rodata);
        build/us/src/dra/gameover.c.o(.rodata);
        build/us/src/dra/46358.c.o(.rodata);
        build/us/src/dra/46FD4.c.o(.rodata);
        build/us/asm/us/dra/data/3B9B8.rodata.s.o(.rodata);
        build/us/asm/us/dra/data/3BD70.rodata.s.o(.rodata);
        build/us/asm/us/dra/data/3BD88.rodata.s.o(.rodata);
        build/us/src/dra/47BB8.c.o(.rodata);
        build/us/src/dra/save_mgr.c.o(.rodata);
        build/us/asm/us/dra/data/3C1A8.rodata.s.o(.rodata);
        build/us/asm/us/dra/data/3C1E8.rodata.s.o(.rodata);
        build/us/asm/us/dra/data/3C228.rodata.s.o(.rodata);
        build/us/asm/us/dra/data/3C238.rodata.s.o(.rodata);
        build/us/src/dra/collider.c.o(.rodata);
        build/us/src/dra/demo.c.o(.rodata);
        build/us/asm/us/dra/data/3C514.rodata.s.o(.rodata);
        build/us/src/dra/52860.c.o(.rodata);
        build/us/asm/us/dra/data/3C55C.rodata.s.o(.rodata);
        build/us/asm/us/dra/data/3C57C.rodata.s.o(.rodata);
        build/us/asm/us/dra/data/3C59C.rodata.s.o(.rodata);
        build/us/asm/us/dra/data/3C5B4.rodata.s.o(.rodata);
        build/us/asm/us/dra/data/3C5D4.rodata.s.o(.rodata);
        build/us/asm/us/dra/data/3C68C.rodata.s.o(.rodata);
        build/us/asm/us/dra/data/3C6AC.rodata.s.o(.rodata);
        build/us/asm/us/dra/data/3C6EC.rodata.s.o(.rodata);
        build/us/asm/us/dra/data/3C71C.rodata.s.o(.rodata);
        build/us/asm/us/dra/data/3C734.rodata.s.o(.rodata);
        build/us/asm/us/dra/data/3C75C.rodata.s.o(.rodata);
        build/us/asm/us/dra/data/3CB7C.rodata.s.o(.rodata);
        build/us/asm/us/dra/data/3CB94.rodata.s.o(.rodata);
        build/us/src/dra/5D6C4.c.o(.rodata);
        build/us/asm/us/dra/data/3CBF4.rodata.s.o(.rodata);
        build/us/src/dra/627C4.c.o(.rodata);
        build/us/asm/us/dra/data/3CC2C.rodata.s.o(.rodata);
        build/us/src/dra/62D70.c.o(.rodata);
        build/us/asm/us/dra/data/3CC70.rodata.s.o(.rodata);
        build/us/asm/us/dra/data/3CC80.rodata.s.o(.rodata);
        build/us/asm/us/dra/data/3CD00.rodata.s.o(.rodata);
        build/us/asm/us/dra/data/3CD10.rodata.s.o(.rodata);
        build/us/asm/us/dra/data/3CDC0.rodata.s.o(.rodata);
        build/us/asm/us/dra/data/3CDDC.rodata.s.o(.rodata);
        build/us/src/dra/cd.c.o(.rodata);
        build/us/asm/us/dra/data/40E28.rodata.s.o(.rodata);
        build/us/asm/us/dra/data/40E48.rodata.s.o(.rodata);
        build/us/src/dra/6D59C.c.o(.rodata);
        build/us/src/dra/704D8.c.o(.rodata);
        build/us/asm/us/dra/data/41320.rodata.s.o(.rodata);
        build/us/asm/us/dra/data/41334.rodata.s.o(.rodata);
        build/us/asm/us/dra/data/41348.rodata.s.o(.rodata);
        build/us/asm/us/dra/data/41360.rodata.s.o(.rodata);
        build/us/asm/us/dra/data/41380.rodata.s.o(.rodata);
        build/us/asm/us/dra/data/413A0.rodata.s.o(.rodata);
        build/us/src/dra/71830.c.o(.rodata);
        build/us/src/dra/71830.c.o(.rodata);
        build/us/src/dra/72BB0.c.o(.rodata);
        build/us/src/dra/72BB0.c.o(.rodata);
        build/us/src/dra/72BB0.c.o(.rodata);
        build/us/src/dra/73AAC.c.o(.rodata);
        build/us/asm/us/dra/data/418F4.rodata.s.o(.rodata);
        build/us/asm/us/dra/data/41908.rodata.s.o(.rodata);
        build/us/asm/us/dra/data/41948.rodata.s.o(.rodata);
        build/us/asm/us/dra/data/41990.rodata.s.o(.rodata);
        build/us/asm/us/dra/data/419B0.rodata.s.o(.rodata);
        build/us/src/dra/75DA0.c.o(.rodata);
        build/us/src/dra/75F54.c.o(.rodata);
        build/us/src/dra/75F54.c.o(.rodata);
        build/us/src/dra/75F54.c.o(.rodata);
        build/us/asm/us/dra/data/41A38.rodata.s.o(.rodata);
        build/us/asm/us/dra/data/41A44.rodata.s.o(.rodata);
        build/us/asm/us/dra/data/41A74.rodata.s.o(.rodata);
        build/us/asm/us/dra/data/41A84.rodata.s.o(.rodata);
        build/us/asm/us/dra/data/41AA4.rodata.s.o(.rodata);
        build/us/asm/us/dra/data/41AB4.rodata.s.o(.rodata);
        build/us/asm/us/dra/data/41AD4.rodata.s.o(.rodata);
        build/us/asm/us/dra/data/41AF4.rodata.s.o(.rodata);
        build/us/asm/us/dra/data/41B44.rodata.s.o(.rodata);
        build/us/asm/us/dra/data/41B74.rodata.s.o(.rodata);
        build/us/asm/us/dra/data/41B94.rodata.s.o(.rodata);
        build/us/asm/us/dra/data/41BF4.rodata.s.o(.rodata);
        build/us/asm/us/dra/data/41C54.rodata.s.o(.rodata);
        build/us/asm/us/dra/data/41CB4.rodata.s.o(.rodata);
        build/us/asm/us/dra/data/41CE4.rodata.s.o(.rodata);
        build/us/asm/us/dra/data/41D1C.rodata.s.o(.rodata);
        build/us/asm/us/dra/data/41D4C.rodata.s.o(.rodata);
        build/us/asm/us/dra/data/41D84.rodata.s.o(.rodata);
        build/us/asm/us/dra/data/41DA4.rodata.s.o(.rodata);
        build/us/asm/us/dra/data/41DBC.rodata.s.o(.rodata);
        build/us/asm/us/dra/data/41DD4.rodata.s.o(.rodata);
        build/us/asm/us/dra/data/41E34.rodata.s.o(.rodata);
        build/us/asm/us/dra/data/41E48.rodata.s.o(.rodata);
        build/us/asm/us/dra/data/41E5C.rodata.s.o(.rodata);
        build/us/asm/us/dra/data/41E7C.rodata.s.o(.rodata);
        build/us/asm/us/dra/data/41E90.rodata.s.o(.rodata);
        build/us/src/dra/8D3E8.c.o(.rodata);
        build/us/src/dra/8D3E8.c.o(.rodata);
        build/us/asm/us/dra/data/41EF0.rodata.s.o(.rodata);
        build/us/asm/us/dra/data/41F18.rodata.s.o(.rodata);
        build/us/asm/us/dra/data/41F30.rodata.s.o(.rodata);
        build/us/asm/us/dra/data/41F58.rodata.s.o(.rodata);
        build/us/asm/us/dra/data/41F70.rodata.s.o(.rodata);
        build/us/asm/us/dra/data/41F98.rodata.s.o(.rodata);
        build/us/asm/us/dra/data/41FB0.rodata.s.o(.rodata);
        build/us/asm/us/dra/data/41FD8.rodata.s.o(.rodata);
        build/us/asm/us/dra/data/42000.rodata.s.o(.rodata);
        build/us/asm/us/dra/data/4202C.rodata.s.o(.rodata);
        build/us/asm/us/dra/data/42034.rodata.s.o(.rodata);
        build/us/asm/us/dra/data/4205C.rodata.s.o(.rodata);
        build/us/asm/us/dra/data/42074.rodata.s.o(.rodata);
        build/us/asm/us/dra/data/4208C.rodata.s.o(.rodata);
        build/us/asm/us/dra/data/420B4.rodata.s.o(.rodata);
        build/us/src/dra/953A0.c.o(.rodata);
        dra_RODATA_END = .;
        dra_RODATA_SIZE = ABSOLUTE(dra_RODATA_END - dra_RODATA_START);
        dra_TEXT_START = .;
        build/us/src/dra/42398.c.o(.text);
        build/us/src/dra/play.c.o(.text);
        build/us/src/dra/gameover.c.o(.text);
        build/us/src/dra/46358.c.o(.text);
        build/us/src/dra/46FD4.c.o(.text);
        build/us/src/dra/47BB8.c.o(.text);
        build/us/src/dra/save_mgr.c.o(.text);
        build/us/src/dra/4A538.c.o(.text);
        build/us/src/dra/collider.c.o(.text);
        build/us/src/dra/demo.c.o(.text);
        build/us/src/dra/5087C.c.o(.text);
        build/us/src/dra/52860.c.o(.text);
        build/us/src/dra/5298C.c.o(.text);
        build/us/src/dra/5D6C4.c.o(.text);
        build/us/src/dra/627C4.c.o(.text);
        build/us/src/dra/62D70.c.o(.text);
        build/us/src/dra/cd.c.o(.text);
        build/us/src/dra/692E8.c.o(.text);
        build/us/src/dra/6D59C.c.o(.text);
        build/us/src/dra/704D8.c.o(.text);
        build/us/src/dra/71830.c.o(.text);
        build/us/src/dra/72BB0.c.o(.text);
        build/us/src/dra/73AAC.c.o(.text);
        build/us/src/dra/75DA0.c.o(.text);
        build/us/src/dra/75F54.c.o(.text);
        build/us/src/dra/8D3E8.c.o(.text);
        build/us/src/dra/953A0.c.o(.text);
        dra_TEXT_END = .;
        dra_TEXT_SIZE = ABSOLUTE(dra_TEXT_END - dra_TEXT_START);
        build/us/asm/us/dra/data/962AC.sbss.s.o(.sbss);
    }
    dra_bss_VRAM = ADDR(.dra_bss);
    .dra_bss (NOLOAD) : SUBALIGN(4)
    {
        dra_BSS_START = .;
        build/us/src/dra/42398.c.o(.bss);
        build/us/src/dra/play.c.o(.bss);
        build/us/src/dra/gameover.c.o(.bss);
        build/us/src/dra/46358.c.o(.bss);
        build/us/src/dra/46FD4.c.o(.bss);
        build/us/src/dra/47BB8.c.o(.bss);
        build/us/src/dra/save_mgr.c.o(.bss);
        build/us/src/dra/4A538.c.o(.bss);
        build/us/src/dra/collider.c.o(.bss);
        build/us/src/dra/demo.c.o(.bss);
        build/us/src/dra/5087C.c.o(.bss);
        build/us/src/dra/52860.c.o(.bss);
        build/us/src/dra/5298C.c.o(.bss);
        build/us/src/dra/5D6C4.c.o(.bss);
        build/us/src/dra/627C4.c.o(.bss);
        build/us/src/dra/62D70.c.o(.bss);
        build/us/src/dra/cd.c.o(.bss);
        build/us/src/dra/692E8.c.o(.bss);
        build/us/src/dra/6D59C.c.o(.bss);
        build/us/src/dra/704D8.c.o(.bss);
        build/us/src/dra/71830.c.o(.bss);
        build/us/src/dra/72BB0.c.o(.bss);
        build/us/src/dra/73AAC.c.o(.bss);
        build/us/src/dra/75DA0.c.o(.bss);
        build/us/src/dra/75F54.c.o(.bss);
        build/us/src/dra/8D3E8.c.o(.bss);
        build/us/src/dra/953A0.c.o(.bss);
        dra_BSS_END = .;
        dra_BSS_SIZE = ABSOLUTE(dra_BSS_END - dra_BSS_START);
    }
    __romPos += SIZEOF(.dra);
    __romPos = ALIGN(__romPos, 16);
    dra_ROM_END = __romPos;
    dra_VRAM_END = .;

    dra_data_ROM_START = __romPos;
    dra_data_VRAM = ADDR(.dra_data);
    .dra_data 0x8013B6A0 : AT(dra_data_ROM_START) SUBALIGN(16)
    {
        dra_data_DATA_START = .;
        dra_data_data__s = .;
        build/us/asm/us/dra/data/dra_data.data.s.o(.data);
        dra_data_DATA_END = .;
        dra_data_DATA_SIZE = ABSOLUTE(dra_data_DATA_END - dra_data_DATA_START);
    }
    __romPos += SIZEOF(.dra_data);
    dra_data_ROM_END = __romPos;
    dra_data_VRAM_END = .;

    /DISCARD/ :
    {
        *(*);
    }
}
