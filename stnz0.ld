SECTIONS
{
    __romPos = 0;
    _gp = 0x0;
    stnz0_ROM_START = __romPos;
    stnz0_VRAM = ADDR(.stnz0);
    .stnz0 0x80180000 : AT(stnz0_ROM_START) SUBALIGN(4)
    {
        stnz0_DATA_START = .;
        _0_data__s = .;
        build/us/asm/us/st/nz0/data/0.data.s.o(.data);
        rooms = .;
        build/us/assets/st/nz0/rooms.o(.data);
        _47C_data__s = .;
        build/us/asm/us/st/nz0/data/47C.data.s.o(.data);
        _18C0_data__s = .;
        build/us/asm/us/st/nz0/data/18C0.data.s.o(.data);
        _1DD0_data__s = .;
        build/us/asm/us/st/nz0/data/1DD0.data.s.o(.data);
        entity_relic_orb_c = .;
        build/us/src/st/nz0/entity_relic_orb.c.o(.data);
        _1ECC_data__s = .;
        build/us/asm/us/st/nz0/data/1ECC.data.s.o(.data);
        _20A0_data__s = .;
        build/us/asm/us/st/nz0/data/20A0.data.s.o(.data);
        _20B0_data__s = .;
        build/us/asm/us/st/nz0/data/20B0.data.s.o(.data);
        _2220_data__s = .;
        build/us/asm/us/st/nz0/data/2220.data.s.o(.data);
        _2600_data__s = .;
        build/us/asm/us/st/nz0/data/2600.data.s.o(.data);
        _2710_data__s = .;
        build/us/asm/us/st/nz0/data/2710.data.s.o(.data);
        g_Rooms = .;
        build/us/assets/st/nz0/g_Rooms.o(.data);
        _2830_data__s = .;
        build/us/asm/us/st/nz0/data/2830.data.s.o(.data);
        _2840_data__s = .;
        build/us/asm/us/st/nz0/data/2840.data.s.o(.data);
        _2850_data__s = .;
        build/us/asm/us/st/nz0/data/2850.data.s.o(.data);
        D_80196A5C = .;
        build/us/assets/st/nz0/D_80196A5C.o(.data);
        D_80196C5C = .;
        build/us/assets/st/nz0/D_80196C5C.o(.data);
        D_80196E5C = .;
        build/us/assets/st/nz0/D_80196E5C.o(.data);
        D_8019725C = .;
        build/us/assets/st/nz0/D_8019725C.o(.data);
        D_80197A5C = .;
        build/us/assets/st/nz0/D_80197A5C.o(.data);
        D_80197C5C = .;
        build/us/assets/st/nz0/D_80197C5C.o(.data);
        D_80197E5C = .;
        build/us/assets/st/nz0/D_80197E5C.o(.data);
        D_8019805C = .;
        build/us/assets/st/nz0/D_8019805C.o(.data);
        D_8019845C = .;
        build/us/assets/st/nz0/D_8019845C.o(.data);
        D_8019865C = .;
        build/us/assets/st/nz0/D_8019865C.o(.data);
        D_8019885C = .;
        build/us/assets/st/nz0/D_8019885C.o(.data);
        D_80198A5C = .;
        build/us/assets/st/nz0/D_80198A5C.o(.data);
        D_8019905C = .;
        build/us/assets/st/nz0/D_8019905C.o(.data);
        D_8019925C = .;
        build/us/assets/st/nz0/D_8019925C.o(.data);
        D_80199C5C = .;
        build/us/assets/st/nz0/D_80199C5C.o(.data);
        D_8019A05C = .;
        build/us/assets/st/nz0/D_8019A05C.o(.data);
        D_8019A45C = .;
        build/us/assets/st/nz0/D_8019A45C.o(.data);
        D_8019AA5C = .;
        build/us/assets/st/nz0/D_8019AA5C.o(.data);
        D_8019AE5C = .;
        build/us/assets/st/nz0/D_8019AE5C.o(.data);
        D_8019BE5C = .;
        build/us/assets/st/nz0/D_8019BE5C.o(.data);
        D_8019C65C = .;
        build/us/assets/st/nz0/D_8019C65C.o(.data);
        D_8019C85C = .;
        build/us/assets/st/nz0/D_8019C85C.o(.data);
        D_8019D45C = .;
        build/us/assets/st/nz0/D_8019D45C.o(.data);
        D_8019D65C = .;
        build/us/assets/st/nz0/D_8019D65C.o(.data);
        D_8019E25C = .;
        build/us/assets/st/nz0/D_8019E25C.o(.data);
        D_8019EE5C = .;
        build/us/assets/st/nz0/D_8019EE5C.o(.data);
        D_8019F25C = .;
        build/us/assets/st/nz0/D_8019F25C.o(.data);
        D_801A005C = .;
        build/us/assets/st/nz0/D_801A005C.o(.data);
        D_801A025C = .;
        build/us/assets/st/nz0/D_801A025C.o(.data);
        D_801A045C = .;
        build/us/assets/st/nz0/D_801A045C.o(.data);
        D_801A065C = .;
        build/us/assets/st/nz0/D_801A065C.o(.data);
        D_801A085C = .;
        build/us/assets/st/nz0/D_801A085C.o(.data);
        _20A5C_data__s = .;
        build/us/asm/us/st/nz0/data/20A5C.data.s.o(.data);
        stnz0_DATA_END = .;
        stnz0_DATA_SIZE = ABSOLUTE(stnz0_DATA_END - stnz0_DATA_START);
        stnz0_RODATA_START = .;
        build/us/src/st/nz0/30958.c.o(.rodata);
        build/us/asm/us/st/nz0/data/305B8.rodata.s.o(.rodata);
        build/us/src/st/nz0/33FCC.c.o(.rodata);
        build/us/src/st/nz0/33FCC.c.o(.rodata);
        build/us/asm/us/st/nz0/data/30618.rodata.s.o(.rodata);
        build/us/src/st/nz0/36DE4.c.o(.rodata);
        build/us/asm/us/st/nz0/data/3064C.rodata.s.o(.rodata);
        build/us/src/st/nz0/3E30C.c.o(.rodata);
        build/us/src/st/nz0/3E30C.c.o(.rodata);
        build/us/src/st/nz0/entity_relic_orb.c.o(.rodata);
        build/us/src/st/nz0/entity_message_box.c.o(.rodata);
        build/us/src/st/nz0/43708.c.o(.rodata);
        build/us/src/st/nz0/43F9C.c.o(.rodata);
        build/us/src/st/nz0/44EAC.c.o(.rodata);
        build/us/src/st/nz0/45F2C.c.o(.rodata);
        build/us/src/st/nz0/4672C.c.o(.rodata);
        build/us/src/st/nz0/47048.c.o(.rodata);
        build/us/src/st/nz0/47958.c.o(.rodata);
        build/us/asm/us/st/nz0/data/308E8.rodata.s.o(.rodata);
        stnz0_RODATA_END = .;
        stnz0_RODATA_SIZE = ABSOLUTE(stnz0_RODATA_END - stnz0_RODATA_START);
        stnz0_TEXT_START = .;
        build/us/src/st/nz0/30958.c.o(.text);
        build/us/src/st/nz0/33FCC.c.o(.text);
        build/us/src/st/nz0/36DE4.c.o(.text);
        build/us/src/st/nz0/random.c.o(.text);
        build/us/src/st/nz0/update.c.o(.text);
        build/us/src/st/nz0/update_stage_entities.c.o(.text);
        build/us/src/st/nz0/39908.c.o(.text);
        build/us/src/st/nz0/3E30C.c.o(.text);
        build/us/src/st/nz0/entity_relic_orb.c.o(.text);
        build/us/src/st/nz0/entity_heart_drop.c.o(.text);
        build/us/src/st/nz0/entity_message_box.c.o(.text);
        build/us/src/st/nz0/4070C.c.o(.text);
        build/us/src/st/nz0/43708.c.o(.text);
        build/us/src/st/nz0/43F9C.c.o(.text);
        build/us/src/st/nz0/44EAC.c.o(.text);
        build/us/src/st/nz0/45F2C.c.o(.text);
        build/us/src/st/nz0/4672C.c.o(.text);
        build/us/src/st/nz0/47048.c.o(.text);
        build/us/src/st/nz0/47958.c.o(.text);
        build/us/src/st/nz0/47CF0.c.o(.text);
        build/us/src/st/nz0/48ADC.c.o(.text);
        build/us/src/st/nz0/49930.c.o(.text);
        stnz0_TEXT_END = .;
        stnz0_TEXT_SIZE = ABSOLUTE(stnz0_TEXT_END - stnz0_TEXT_START);
        build/us/asm/us/st/nz0/data/4AA10.sbss.s.o(.sbss);
    }
    stnz0_bss_VRAM = ADDR(.stnz0_bss);
    .stnz0_bss (NOLOAD) : SUBALIGN(4)
    {
        stnz0_BSS_START = .;
        build/us/src/st/nz0/30958.c.o(.bss);
        build/us/src/st/nz0/33FCC.c.o(.bss);
        build/us/src/st/nz0/36DE4.c.o(.bss);
        build/us/src/st/nz0/random.c.o(.bss);
        build/us/src/st/nz0/update.c.o(.bss);
        build/us/src/st/nz0/update_stage_entities.c.o(.bss);
        build/us/src/st/nz0/39908.c.o(.bss);
        build/us/src/st/nz0/3E30C.c.o(.bss);
        build/us/src/st/nz0/entity_relic_orb.c.o(.bss);
        build/us/src/st/nz0/entity_heart_drop.c.o(.bss);
        build/us/src/st/nz0/entity_message_box.c.o(.bss);
        build/us/src/st/nz0/4070C.c.o(.bss);
        build/us/src/st/nz0/43708.c.o(.bss);
        build/us/src/st/nz0/43F9C.c.o(.bss);
        build/us/src/st/nz0/44EAC.c.o(.bss);
        build/us/src/st/nz0/45F2C.c.o(.bss);
        build/us/src/st/nz0/4672C.c.o(.bss);
        build/us/src/st/nz0/47048.c.o(.bss);
        build/us/src/st/nz0/47958.c.o(.bss);
        build/us/src/st/nz0/47CF0.c.o(.bss);
        build/us/src/st/nz0/48ADC.c.o(.bss);
        build/us/src/st/nz0/49930.c.o(.bss);
        stnz0_BSS_END = .;
        stnz0_BSS_SIZE = ABSOLUTE(stnz0_BSS_END - stnz0_BSS_START);
    }
    __romPos += SIZEOF(.stnz0);
    __romPos = ALIGN(__romPos, 16);
    stnz0_ROM_END = __romPos;
    stnz0_VRAM_END = .;

    /DISCARD/ :
    {
        *(*);
    }
}
