SECTIONS
{
    __romPos = 0;
    _gp = 0x0;
    stnp3_ROM_START = __romPos;
    stnp3_VRAM = ADDR(.stnp3);
    .stnp3 0x80180000 : AT(stnp3_ROM_START) SUBALIGN(4)
    {
        stnp3_DATA_START = .;
        _0_data__s = .;
        build/us/asm/us/st/np3/data/0.data.s.o(.data);
        E50_data__s = .;
        build/us/asm/us/st/np3/data/E50.data.s.o(.data);
        _10C0_data__s = .;
        build/us/asm/us/st/np3/data/10C0.data.s.o(.data);
        _1300_data__s = .;
        build/us/asm/us/st/np3/data/1300.data.s.o(.data);
        _1520_data__s = .;
        build/us/asm/us/st/np3/data/1520.data.s.o(.data);
        entity_relic_orb_c = .;
        build/us/src/st/np3/entity_relic_orb.c.o(.data);
        _1FA4_data__s = .;
        build/us/asm/us/st/np3/data/1FA4.data.s.o(.data);
        _22B0_data__s = .;
        build/us/asm/us/st/np3/data/22B0.data.s.o(.data);
        _23D0_data__s = .;
        build/us/asm/us/st/np3/data/23D0.data.s.o(.data);
        _2400_data__s = .;
        build/us/asm/us/st/np3/data/2400.data.s.o(.data);
        _2440_data__s = .;
        build/us/asm/us/st/np3/data/2440.data.s.o(.data);
        _2720_data__s = .;
        build/us/asm/us/st/np3/data/2720.data.s.o(.data);
        _2740_data__s = .;
        build/us/asm/us/st/np3/data/2740.data.s.o(.data);
        _2A20_data__s = .;
        build/us/asm/us/st/np3/data/2A20.data.s.o(.data);
        _2B00_data__s = .;
        build/us/asm/us/st/np3/data/2B00.data.s.o(.data);
        _3010_data__s = .;
        build/us/asm/us/st/np3/data/3010.data.s.o(.data);
        _33A0_data__s = .;
        build/us/asm/us/st/np3/data/33A0.data.s.o(.data);
        _3530_data__s = .;
        build/us/asm/us/st/np3/data/3530.data.s.o(.data);
        _3570_data__s = .;
        build/us/asm/us/st/np3/data/3570.data.s.o(.data);
        _3580_data__s = .;
        build/us/asm/us/st/np3/data/3580.data.s.o(.data);
        _3720_data__s = .;
        build/us/asm/us/st/np3/data/3720.data.s.o(.data);
        _3760_data__s = .;
        build/us/asm/us/st/np3/data/3760.data.s.o(.data);
        g_Rooms = .;
        build/us/assets/st/np3/g_Rooms.o(.data);
        _3B68_data__s = .;
        build/us/asm/us/st/np3/data/3B68.data.s.o(.data);
        _31EA0_data__s = .;
        build/us/asm/us/st/np3/data/31EA0.data.s.o(.data);
        stnp3_DATA_END = .;
        stnp3_DATA_SIZE = ABSOLUTE(stnp3_DATA_END - stnp3_DATA_START);
        stnp3_RODATA_START = .;
        build/us/src/st/np3/3246C.c.o(.rodata);
        build/us/src/st/np3/365FC.c.o(.rodata);
        build/us/src/st/np3/36990.c.o(.rodata);
        build/us/asm/us/st/np3/data/31EDC.rodata.s.o(.rodata);
        build/us/asm/us/st/np3/data/31F00.rodata.s.o(.rodata);
        build/us/src/st/np3/3DEF4.c.o(.rodata);
        build/us/src/st/np3/entity_relic_orb.c.o(.rodata);
        build/us/src/st/np3/entity_message_box.c.o(.rodata);
        build/us/asm/us/st/np3/data/31FEC.rodata.s.o(.rodata);
        build/us/asm/us/st/np3/data/3200C.rodata.s.o(.rodata);
        build/us/src/st/np3/44DCC.c.o(.rodata);
        build/us/src/st/np3/48238.c.o(.rodata);
        build/us/src/st/np3/490E8.c.o(.rodata);
        build/us/src/st/np3/4997C.c.o(.rodata);
        build/us/src/st/np3/49BC8.c.o(.rodata);
        build/us/src/st/np3/49F98.c.o(.rodata);
        build/us/asm/us/st/np3/data/320DC.rodata.s.o(.rodata);
        build/us/src/st/np3/4B018.c.o(.rodata);
        build/us/asm/us/st/np3/data/3224C.rodata.s.o(.rodata);
        build/us/asm/us/st/np3/data/322CC.rodata.s.o(.rodata);
        build/us/asm/us/st/np3/data/322F8.rodata.s.o(.rodata);
        build/us/src/st/np3/4E69C.c.o(.rodata);
        build/us/asm/us/st/np3/data/323E4.rodata.s.o(.rodata);
        stnp3_RODATA_END = .;
        stnp3_RODATA_SIZE = ABSOLUTE(stnp3_RODATA_END - stnp3_RODATA_START);
        stnp3_TEXT_START = .;
        build/us/src/st/np3/3246C.c.o(.text);
        build/us/src/st/np3/365FC.c.o(.text);
        build/us/src/st/np3/36990.c.o(.text);
        build/us/src/st/np3/random.c.o(.text);
        build/us/src/st/np3/update.c.o(.text);
        build/us/src/st/np3/update_stage_entities.c.o(.text);
        build/us/src/st/np3/394F0.c.o(.text);
        build/us/src/st/np3/3DEF4.c.o(.text);
        build/us/src/st/np3/entity_relic_orb.c.o(.text);
        build/us/src/st/np3/entity_heart_drop.c.o(.text);
        build/us/src/st/np3/entity_message_box.c.o(.text);
        build/us/src/st/np3/402F4.c.o(.text);
        build/us/src/st/np3/44DCC.c.o(.text);
        build/us/src/st/np3/48238.c.o(.text);
        build/us/src/st/np3/490E8.c.o(.text);
        build/us/src/st/np3/4997C.c.o(.text);
        build/us/src/st/np3/49BC8.c.o(.text);
        build/us/src/st/np3/49F98.c.o(.text);
        build/us/src/st/np3/4B018.c.o(.text);
        build/us/src/st/np3/4E69C.c.o(.text);
        stnp3_TEXT_END = .;
        stnp3_TEXT_SIZE = ABSOLUTE(stnp3_TEXT_END - stnp3_TEXT_START);
        build/us/asm/us/st/np3/data/52768.sbss.s.o(.sbss);
    }
    __romPos += SIZEOF(.stnp3);
    __romPos = ALIGN(__romPos, 16);
    stnp3_ROM_END = __romPos;
    stnp3_VRAM_END = .;

    /DISCARD/ :
    {
        *(*);
    }
}
